## linux/arch/arm/mach-at91rm9200/Kconfig
```kconfig
if ARCH_AT91RM9200

menu "AT91RM9200 Implementations"

config ARCH_AT91RM9200DK
	bool "Atmel AT91RM9200-DK Development board"
	depends on ARCH_AT91RM9200
	help
	  Select this if you are using Atmel's AT91RM9200-DK Development board

config MACH_AT91RM9200EK
	bool "Atmel AT91RM9200-EK Evaluation Kit"
	depends on ARCH_AT91RM9200
	help
	  Select this if you are using Atmel's AT91RM9200-EK Evaluation Kit

config MACH_CSB337
	bool "Cogent CSB337 board"
	depends on ARCH_AT91RM9200
	help
	  Select this if you are using Cogent's CSB337 board

config MACH_CSB437TL
	bool "Cogent CSB437TL board"
	depends on ARCH_AT91RM9200
	help
	  Select this if you are using Cogent's CSB437TL board

config MACH_CSB437TL_REV
        int "  Hardware revision number (2, 4 tested)"
        depends on MACH_CSB437TL
        help
          Specify which hardware revision number you are using,
          i.e. "2", "4", etc.

config MACH_CSB637
	bool "Cogent CSB637 board"
	depends on ARCH_AT91RM9200
	help
	  Select this if you are using Cogent's CSB637 board

config MACH_CARMEVA
	bool "Conitec's ARM&EVA"
	depends on ARCH_AT91RM9200
	help
	  Select this if you are using Conitec's AT91RM9200-MCU-Module

endmenu

endif
```

## linux/arch/arm/mach-imx/Kconfig
```kconfig
menu "IMX Implementations"
	depends on FAMILY_IMX

choice
	prompt "Select IMX-based board"
	default ARCH_MX1ADS

config ARCH_MX1ADS
	bool "mx1ads"
	depends on FAMILY_IMX
	select ARCH_IMX
	select ISA
	help
	  Say Y here if you are using the Motorola MX1ADS board

config MACH_CSB535
	bool "CSB535"
	depends on FAMILY_IMX
	select ARCH_IMX21
	help
	  Say Y here if you are using the Cogent CSB535 board.
 
config MACH_CSB536
	bool "Cogent CSB536 board"
	depends on ARCH_IMX
	help
	  Say Y here if you are using the Cogent CSB536 board.

config ARCH_MX2ADS
	bool "mx2ads"
	depends on FAMILY_IMX
	select ARCH_IMX21
	default y if FAMILY_IMX
	help
	  Say Y here if you are using the Freescale MX21ADS board
 
endchoice

choice
	prompt "Select CSB536 variant"
	depends on MACH_CSB536
	default MACH_CSB536FS

config MACH_CSB536FS
	bool "Cogent CSB536FS board"
	depends on MACH_CSB536
	help
	  Say Y here if you are using the Cogent CSB536FS board.

config MACH_CSB536PC
	bool "Cogent CSB536PC board"
	depends on MACH_CSB536
	help
	  Say Y here if you are using the Cogent CSB536PC board.


endchoice

config UMON_SHIM
	bool "Shim uMON's call command"
	depends on MACH_CSB536 || MACH_CSB535
	default n
	help
		Select Y to add an assembly language "shim" to the bootloader
		that maps the parameters as they are passed by older versions
		of uMON to the ATAGS parameter passing convention supported by
		the latest arm-linux kernels.  If in doubt, select yes.

endmenu

config ARCH_IMX
	bool
config ARCH_IMX21
	bool
```

## linux/arch/arm/mach-pxa/Kconfig
```kconfig
if ARCH_PXA

menu "Intel PXA2xx Implementations"

choice
	prompt "Select target board"

config ARCH_CSB226
       bool "Cogent CSB226"
       select PXA25x

config MACH_CSB625
       bool "Cogent CSB625"
       select PXA25x

config MACH_CSB625_REV
       int "   Hardware revision number (2, 3, etc.)"
       depends on MACH_CSB625
       default 3
       help
         Specify which hardware revision number of the CSB625 (not
         the CSB925 breakout board, if present) you are using,
         i.e. "2", "3", "4", etc.  If you aren't sure, look for the
         text "REV.P*" in one corner of your board, or just keep trying
         until you get a kernel that works.  :^)
         (Revision 3 is the first production version).

config ARCH_LUBBOCK
	bool "Intel DBPXA250 Development Platform"
	select PXA25x
	select SA1111

config MACH_MAINSTONE
	bool "Intel HCDDBBVA0 Development Platform"
	select PXA27x
	select IWMMXT

config ARCH_PXA_IDP
	bool "Accelent Xscale IDP"
	select PXA25x

config PXA_SHARPSL
	bool "SHARP SL-5600 and SL-C7xx Models"
	select PXA25x
	select SHARP_SCOOP
	select SHARP_PARAM
	help
	  Say Y here if you intend to run this kernel on a
	  Sharp SL-5600 (Poodle), Sharp SL-C700 (Corgi),
	  SL-C750 (Shepherd) or a Sharp SL-C760 (Husky)
	  handheld computer.

endchoice

endmenu

config MACH_POODLE
	bool "Enable Sharp SL-5600 (Poodle) Support"
	depends PXA_SHARPSL
	select SHARP_LOCOMO

config MACH_CORGI
	bool "Enable Sharp SL-C700 (Corgi) Support"
	depends PXA_SHARPSL
	select PXA_SHARP_C7xx

config MACH_SHEPHERD
	bool "Enable Sharp SL-C750 (Shepherd) Support"
	depends PXA_SHARPSL
	select PXA_SHARP_C7xx

config MACH_HUSKY
	bool "Enable Sharp SL-C760 (Husky) Support"
	depends PXA_SHARPSL
	select PXA_SHARP_C7xx

config PXA25x
	bool
	help
	  Select code specific to PXA21x/25x/26x variants

config PXA27x
	bool
	help
	  Select code specific to PXA27x variants

config IWMMXT
	bool
	help
	  Enable support for iWMMXt

config PXA_SHARP_C7xx
	bool
	help
	  Enable support for all Sharp C7xx models

config PXA_UART_ASSIGNMENTS
        bool "  Specify non-default UART/port assignments"
        help
          Select to specify which UART becomes ttyS0,
          ttyS1, and ttyS2.  If you don't know, select N and a
          suitable set of defaults will be assigned.

config PXA_FFUART_ASSIGNMENT
        int "   FFUART"
        depends on PXA_UART_ASSIGNMENTS
        default 0
        
config PXA_BTUART_ASSIGNMENT
        int "   BTUART"
        depends on PXA_UART_ASSIGNMENTS
        default 1
        
config PXA_STUART_ASSIGNMENT
        int "   STUART"
        depends on PXA_UART_ASSIGNMENTS
        default 2

endif
```

## linux/drivers/mmc/Kconfig
```kconfig
#
# MMC subsystem configuration
#

menu "MMC/SD Card support"

config MMC
	tristate "MMC support"
	help
	  MMC is the "multi-media card" bus protocol.

	  If you want MMC support, you should say Y here and also
	  to the specific driver for your MMC interface.

config MMC_DEBUG
	bool "MMC debugging"
	depends on MMC != n
	help
	  This is an option for use by developers; most people should
	  say N here.  This enables MMC core and driver debugging.

config MMC_BLOCK
	tristate "MMC block device driver"
	depends on MMC
	default y
	help
	  Say Y here to enable the MMC block device driver support.
	  This provides a block device driver, which you can use to
	  mount the filesystem. Almost everyone wishing MMC support
	  should say Y or M here.

config MMC_ARMMMCI
	tristate "ARM AMBA Multimedia Card Interface support"
	depends on ARM_AMBA && MMC
	help
	  This selects the ARM(R) AMBA(R) PrimeCell Multimedia Card
	  Interface (PL180 and PL181) support.  If you have an ARM(R)
	  platform with a Multimedia Card slot, say Y or M here.

	  If unsure, say N.

config MMC_PXA
	tristate "Intel PXA255 Multimedia Card Interface support"
	depends on ARCH_PXA && MMC
	help
	  This selects the Intel(R) PXA(R) Multimedia card Interface.
	  If you have a PXA(R) platform with a Multimedia Card slot,
	  say Y or M here.

	  If unsure, say N.

config MMC_WBSD
	tristate "Winbond W83L51xD SD/MMC Card Interface support"
	depends on MMC && ISA_DMA_API
	help
	  This selects the Winbond(R) W83L51xD Secure digital and
          Multimedia card Interface.
	  If you have a machine with a integrated W83L518D or W83L519D
	  SD/MMC card reader, say Y or M here.

	  If unsure, say N.

config MMC_AT91RM9200
	tristate "AT91RM9200 SD/MMC Card Interface support"
	depends on ARCH_AT91RM9200 && MMC
	help
	  This selects the AT91RM9200 MCI controller.

	  If unsure, say N.
	
config MMC_CSB536FS
	tristate "MMC Card support on CSB536FS"
	depends on MACH_CSB536FS && MMC
	help
	  This selects the SPI MMC interface on the CSB536FS

	  If unsure, say N.

config MMC_CSB536PC
	tristate "MMC Card support on CSB536PC"
	depends on MACH_CSB536PC && MMC
	help
	  This selects the SPI MMC interface on the CSB536PC

	  If unsure, say N.

config MMC_IMX
	tristate "Motorola i.MX Multimedia Card Interface support"
	depends on ARCH_IMX && MMC
	help
	  This selects the Motorola i.MX Multimedia card Interface.
	  If you have a i.MX platform with a Multimedia Card slot,
	  say Y or M here.

	  If unsure, say N.

	
endmenu
```

## linux/sound/arm/Kconfig
```kconfig
menu "ALSA ARM devices"
	depends on SND!=n && ARM

config SND_PXA2XX_AC97
	tristate "AC97 driver for the Intel PXA2xx chip"
	depends on ARCH_PXA && SND
	select SND_PXA2XX_PCM
	select SND_AC97_CODEC
	help
	  Say Y or M if you want to support any AC97 codec attached to
	  the PXA2xx AC97 interface.

config SND_PXA2XX_PCM
	tristate
	select SND_PCM
	help
	  Generic PCM module for PXA2xx

config SND_S3C2410
	tristate "S3C24XX Sound core"
	depends on ARCH_S3C2410 && SND
	select I2C_SENSOR
	select SND_PCM
	help
	  Say Y here if you want to use the inbuilt audio controller
	  on the S3C2410 or S3C2440

config SND_CSB536FS
	tristate "CSB536FS audio driver"
	depends on MACH_CSB536FS && SND
	select I2C
	select I2C_IMX
	select WM8731
	select SND_PCM
	help
	  ALSA Sound driver for the CSB536FS

config SND_CSB536PC
	tristate "CSB536PC audio driver"
	depends on MACH_CSB536_PC && SND
	select I2C_IMX
	select WM8731
	select SND_PCM
	help
	  ALSA Sound driver for the CSB536PC

endmenu
```
